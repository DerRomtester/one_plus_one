## aio/Kconfig
```kconfig
menu "Optization Flags"
  menu "Target Specifications"
	config TARGET_DEVICE_TUNING
		bool "Tune to your device?"
		help
			Set to y if you plan on adding the device specification tunings
			 TARGET_CPU, TARGET_ARCH, TARGET_ABI, TARGET_CPU_CORES,
			 TARGET_NEON_CORES, and TARGET_FPU.

	config TARGET_CPU
		string "CPU Type"
		help
			Common ARM CPUs include: ‘cortex-a5’, ‘cortex-a7’, ‘cortex-a8’,
			 ‘cortex-a9’, ‘cortex-a12’, ‘cortex-a15’, ‘cortex-a53’, ‘cortex-a57’,
			 ‘cortex-a72’, ‘cortex-r4’, ‘cortex-r4f’, ‘cortex-r5’, ‘cortex-r7’,
			 ‘cortex-m7’, ‘cortex-m4’, ‘cortex-m3’, ‘cortex-m1’, ‘cortex-m0’, 
			 ‘cortex-m0plus’, and ‘exynos-m1’. 

	config TARGET_ARCH
		string "Architecture"
		help
			Common ARM Architectures include: ‘armv7’, ‘armv7-a’, ‘armv7-r’,
			 ‘armv7-m’, ‘armv7e-m’, ‘armv7ve’, and ‘armv8-a’.

	config TARGET_ABI
		string "Architecture"
		default "soft"
		help
			Hard or soft ARM floating point abis.

	config TARGET_CPU_CORES
		string "Cores"
		default "0"
		help
	`		The number of cores in the target's CPU, usually 2, 4, or 8.

	config TARGET_NEON_CORES
		string "Cores"
		default "quad"
		help
			The number of cores in sequential numbers (double or quad).

	config TARGET_FPU_SETTING
`		string "Device FPU"
		help
			Common FPUs include: ‘vfp’, ‘vfpv3’, ‘vfpv3-fp16’, ‘vfpv3-d16’,
			 ‘vfpv3-d16-fp16’, ‘vfpv3xd’, ‘vfpv3xd-fp16’, ‘neon’, ‘neon-fp16’,
			 ‘vfpv4’, ‘vfpv4-d16’, ‘fpv4-sp-d16’, ‘neon-vfpv4’, ‘fpv5-d16’,
			 ‘fpv5-sp-d16’, ‘fp-armv8’, ‘neon-fp-armv8’, and ‘crypto-neon-fp-armv8’. 

	config TARGET_L1_CACHE_SIZE
		int "L1 Cache Size"
		help
			CPU level 1 cache size.

	config TARGET_L2_CACHE_SIZE
		int "L2 Cache Size"
		help 
			CPU level 2 cache size.
  endmenu

  menu "Preset Optimization Configurations"

	config MEMORY_OPTS
		bool "Memory Optimizations"
		help
			 This preset majorly targets memory/RAM performance.

	config CPU_OPTS
		bool "CPU Optimizations"
		help
			 This preset majorly targets CPU performance.

	config SAFE_OPTS
		bool "Safe Optimizations"
		help
			 This preset includes all optimizations that aren't known to
			  cause bugs/anomalies.

	config BATTERY_OPTS
		bool "Battery Optimizations"
		help
			 This preset includes optimizations that don't affect battery
			  and/or improve it.

	config MAX_OPTS
		bool "Max Optimizations"
		help
			 This preset includes all optimizations. WARNING: MAY HARM
			  PERFORMANCE/BATTERY

	config ALL_AROUND_OPTS
		bool "All Around Optimizations"
		help
			This preset has various optimizations that have been tested
			 (on some devices) to provide the best all around results.
  endmenu

  menu "Single Flags/Flag Groups"
	config GRAPHITE
		bool
		help 
			Enable basic Pluto based Graphite and Graphite Loop polyhedral 
			 optimizations. 

	config PIPE
		bool
		help
			Enable -pipe.

	config PTHREAD
		bool
		help
			Enable the Posix threading scheme for better thread handling.

	config O3
		bool
		help
			Enable -O3 and extra -Werror nulling flags.

	config FAST_MATH
		bool
		help
			Enable -ffast-math for mathematics calulation optimizations.

	config LTO
		bool
		help
			Enable Link time optimizations on LD (linker).

 	config DNDEBUG
		bool
		help
			Disable some debugging.

	config TUNE
		bool
		depends on TARGET_DEVICE_TUNING
		depends on TARGET_CPU
		depends on TARGET_ARCH
		depends on TARGET_ABI
		depends on TARGET_CPU_CORES
		depends on TARGET_NEON_CORES
		depends on TARGET_FPU
		help
			Add device specific tuning flags (Depend on strings TARGET_CPU,
			 TARGET_ARCH, TARGET_ABI, TARGET_CPU_CORES, TARGET_NEON_CORES,
			 and TARGET_FPU being set in defconfig).

	config PARAMETERS
		bool
		depends on TARGET_L1_CACHE_SIZE
		depends on TARGET_L2_CACHE_SIZE
		help
			Optimizes code for CPU cache size (Depends on TARGET_L1_CACHE_SIZE
			 and TARGET_L2_CACHE_SIZE).

	config MODULO_SCHED
		bool
		help
			Enables -fmodulo-sched and -fmodulo-sched-allow-regmoves flags to 
			 modulo scheduling before the first scheduling pass and allows 
			 register moves.

	config EXTRA_LOOP
		bool
		help
			Enables loop optimizations for faster/more efficient loop computation.

	config STRICT_ALIASING
		bool
		help
			Enables -fstrict-aliasing, but may require extra fixes depending on
			 your kernel.
  endmenu
endmenu
```
